## build/conf/bblayers.conf
```bitbake
# POKY_BBLAYERS_CONF_VERSION is increased each time build/conf/bblayers.conf
# changes incompatibly
POKY_BBLAYERS_CONF_VERSION = "2"

BBPATH = "${TOPDIR}"
BBFILES ?= ""

BBLAYERS ?= " \
  /home/seame/HU_TEAM5/poky/meta \
  /home/seame/HU_TEAM5/poky/meta-poky \
  /home/seame/HU_TEAM5/poky/meta-yocto-bsp \
  /home/seame/HU_TEAM5/meta-openembedded/meta-oe \
  /home/seame/HU_TEAM5/meta-openembedded/meta-multimedia \
  /home/seame/HU_TEAM5/meta-openembedded/meta-networking \
  /home/seame/HU_TEAM5/meta-openembedded/meta-python \
  /home/seame/HU_TEAM5/meta-openembedded/meta-python2 \
  /home/seame/HU_TEAM5/meta-raspberrypi \
  /home/seame/HU_TEAM5/meta-qt5 \
  /home/seame/HU_TEAM5/meta-team5 \
  "
```

## meta-team5/conf/layer.conf
```bitbake
# We have a conf and classes directory, add to BBPATH
BBPATH .= ":${LAYERDIR}"

# We have recipes-* directories, add to BBFILES
BBFILES += "${LAYERDIR}/recipes-*/*/*.bb \
            ${LAYERDIR}/recipes-*/*/*.bbappend"

BBFILE_COLLECTIONS += "meta-team5"
BBFILE_PATTERN_meta-team5 = "^${LAYERDIR}/"
BBFILE_PRIORITY_meta-team5 = "6"

LAYERDEPENDS_meta-team5 = "core"
LAYERSERIES_COMPAT_meta-team5 = "scarthgap"
```
